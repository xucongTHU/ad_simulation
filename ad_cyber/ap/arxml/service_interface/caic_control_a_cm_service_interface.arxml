AUTOSAR XML (schema 00048)
package /Caic/DataType
  compu method DrivingModeControl: 0=COMPLETE_MANUAL, 1=COMPLETE_AUTO_DRIVE, 2=AUTO_STEER_ONLY, 3=AUTO_SPEED_ONLY, 4=EMERGENCY_MODE
  std cpp implementation data type ControlCommand: category=STRUCTURE
    namespaces:
      symbol props caic_control_mdc
    20 x cpp implementation data type element:
      header: type-reference=Header
      meta: type-reference=ControlMeta
      available: type-reference=uint64_t
      throttle: type-reference=double
      brake: type-reference=double
      steering_target: type-reference=double
      steering_rate: type-reference=double
      steering_torque: type-reference=double
      speed: type-reference=double
      acceleration: type-reference=double
      parking_distance: type-reference=double
      parking_brake: type-reference=bool
      engine_on_off: type-reference=bool
      is_estop: type-reference=bool
      driving_mode: type-reference=DrivingModeControl
      gear_state: type-reference=GearState
      vehicle_signal: type-reference=VehicleSignal
      stand_still: type-reference=bool
      rearview_mirror: type-reference=bool
      reserved_info: type-reference=String
  std cpp implementation data type ControlMeta: category=STRUCTURE
    namespaces:
      symbol props caic_control_mdc
    5 x cpp implementation data type element, all with type-reference=int64_t:
      planning_timestamp_us
      localization_timestamp_us
      chassis_timestamp_us
      start_timestamp_us
      finish_timestamp_us
package /Caic/ServiceInterface
  service interface CaicControlServiceInterface
    namespaces:
      symbol props caic_control_mdc
    events:
      data CaicControlEvent: type=ControlCommand
package /Caic/Deployment
  dds service interface deployment CaicControlDdsServiceInterfaceDeployment: service-interface=CaicControlServiceInterface, service-interface-id=24003
    dds event deployment CaicControlEventDeployment: event=CaicControlEvent, frag-size=5242800, list-size=100, topic-name=CaicControlEventNotifier
