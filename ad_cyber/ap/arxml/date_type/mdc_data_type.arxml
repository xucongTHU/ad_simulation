AUTOSAR XML (schema 00048)
package /HuaweiMDC/ComplexDataTypeDemo
  5 x std cpp implementation data type:
    ByteArray: category=ARRAY, array-size=5, cpp-template-argument=UInt8
    DoubleVector: category=VECTOR, cpp-template-argument=Double
    MapWithBoolAndByte: category=ASSOCIATIVE_MAP, template-arguments=[Boolean, UInt8]
    StructWithBoolAndByte: category=STRUCTURE
      cpp implementation data type element BoolData: type-reference=Boolean
      cpp implementation data type element ByteData: type-reference=UInt8
    RawData: category=VECTOR, cpp-template-argument=UInt8
package /HuaweiMDC/StdCppBasicDataType
  11 x std cpp implementation data type, all with category=VALUE:
    bool
    double
    float
    int16_t
    int32_t
    int64_t
    int8_t
    uint16_t
    uint32_t
    uint64_t
    uint8_t
package /HuaweiMDC/StdCppDataType
  13 x std cpp implementation data type:
    Boolean: type-reference=bool
    Double: type-reference=double
    Float: type-reference=float
    Int16: type-reference=int16_t
    Int32: type-reference=int32_t
    Int64: type-reference=int64_t
    Int8: type-reference=int8_t
    String: category=STRING
    UInt16: type-reference=uint16_t
    UInt32: type-reference=uint32_t
    UInt64: type-reference=uint64_t
    UInt8: type-reference=uint8_t
    rawBuffer: category=RAWBUFFER
