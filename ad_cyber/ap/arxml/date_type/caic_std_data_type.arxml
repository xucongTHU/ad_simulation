AUTOSAR XML (schema 00048)
package /Caic
  5 x std cpp implementation data type, all with category=STRUCTURE:
    Header
      namespaces:
        symbol props caic_std_mdc
      cpp implementation data type element seq: type-reference=uint32_t
      cpp implementation data type element stamp: type-reference=int64_t
      cpp implementation data type element frame_id: type-reference=String
    Point3d
      namespaces:
        symbol props caic_std_mdc
      cpp implementation data type element x: type-reference=double
      cpp implementation data type element y: type-reference=double
      cpp implementation data type element z: type-reference=double
    Point2d
      namespaces:
        symbol props caic_std_mdc
      cpp implementation data type element x: type-reference=double
      cpp implementation data type element y: type-reference=double
    Vector3d
      namespaces:
        symbol props caic_std_mdc
      cpp implementation data type element x: type-reference=double
      cpp implementation data type element y: type-reference=double
      cpp implementation data type element z: type-reference=double
    Vector2d
      namespaces:
        symbol props caic_std_mdc
      cpp implementation data type element x: type-reference=double
      cpp implementation data type element y: type-reference=double
  compu method GearState: 0=NEUTRAL, 1=DRIVE, 2=REVERSE, 3=PARKING, 4=LOW, 5=INVALID, 6=NONE
  compu method TurnSignal: 0=TURN_NONE, 1=TURN_LEFT, 2=TURN_RIGHT
  std cpp implementation data type VehicleSignal: category=STRUCTURE
    namespaces:
      symbol props caic_control_mdc
    5 x cpp implementation data type element:
      turn_signal: type-reference=TurnSignal
      high_beam: type-reference=bool
      low_beam: type-reference=bool
      horn: type-reference=bool
      emergency_light: type-reference=bool
