AUTOSAR XML (schema 00048)
package /HuaweiMDC/ModeDeclaration
  8 x mode declaration group:
    EventAsyncSampleFunctionGroup: category=FunctionGroup, initial-mode=EventAsyncSampleFunctionGroup/Off
      4 x mode:
        Off: value=1
        Restart: value=3
        Running: value=2
        Shutdown: value=4
      4 x mode transition:
        OffToRunning: entered-mode=EventAsyncSampleFunctionGroup/Running, exited-mode=EventAsyncSampleFunctionGroup/Off
        RunningToOff: entered-mode=EventAsyncSampleFunctionGroup/Off, exited-mode=EventAsyncSampleFunctionGroup/Running
        RunningToShutdown: entered-mode=EventAsyncSampleFunctionGroup/Shutdown, exited-mode=EventAsyncSampleFunctionGroup/Running
        RunningToRestart: entered-mode=EventAsyncSampleFunctionGroup/Restart, exited-mode=EventAsyncSampleFunctionGroup/Running
    ProcessState: category=Process, initial-mode=Idle
      mode Idle
      mode Running
      mode Terminated
    Sample: category=FunctionGroup, initial-mode=Sample/Off
      mode Off: value=1
      mode Running: value=2
      mode transition OffToRunning: entered-mode=Sample/Running, exited-mode=Sample/Off
      mode transition RunningToOff: entered-mode=Sample/Off, exited-mode=Sample/Running
    SmSampleFG0: category=FunctionGroup, initial-mode=SmSampleFG0/Off
      mode Off: value=1
      mode Running: value=2
      mode transition OffToRunning: entered-mode=SmSampleFG0/Running, exited-mode=SmSampleFG0/Off
      mode transition RunningToOff: entered-mode=SmSampleFG0/Off, exited-mode=SmSampleFG0/Running
    SmSampleFG1: category=FunctionGroup, initial-mode=SmSampleFG1/Off
      4 x mode:
        Off: value=1
        StateA: value=2
        StateB: value=3
        StateC: value=4
      4 x mode transition:
        OffToStateA: entered-mode=SmSampleFG1/StateA, exited-mode=SmSampleFG1/Off
        StateAToStateB: entered-mode=SmSampleFG1/StateB, exited-mode=SmSampleFG1/StateA
        StateBToStateC: actions=[SmSampleFG1/StateC, SmSampleFG2/StateC], entered-mode=SmSampleFG1/StateC, exited-mode=SmSampleFG1/StateB
        StateCToOff: entered-mode=SmSampleFG1/Off, exited-mode=SmSampleFG1/StateC
    SmSampleFG2: category=FunctionGroup, initial-mode=SmSampleFG2/Off
      4 x mode:
        Off: value=1
        StateA: value=2
          dependencies:
            mode dependency Deps: states=SmSampleFG1/StateA
        StateB: value=3
          mode conflict Conflicts: states=SmSampleFG1/StateC
        StateC: value=4
      4 x mode transition:
        OffToStateA: entered-mode=SmSampleFG2/StateA, exited-mode=SmSampleFG2/Off
        StateAToStateB: entered-mode=SmSampleFG2/StateB, exited-mode=SmSampleFG2/StateA
        StateBToStateC: entered-mode=SmSampleFG2/StateC, exited-mode=SmSampleFG2/StateB
        StateCToOff: entered-mode=SmSampleFG2/Off, exited-mode=SmSampleFG2/StateC
    Access: initial-mode=Access/Off
      mode Off
      mode Running
      mode transition OffToRunning: entered-mode=Access/Running, exited-mode=Access/Off
      mode transition RunningToOff: entered-mode=Access/Off, exited-mode=Access/Running
    MachineState: category=FunctionGroup, initial-mode=PreStartup
      9 x mode:
        Off
        Reset
        Restart: value=2
        Shutdown: value=1
        Standby
        Startup: value=0
        Update
        Verify
        PreStartup: value=0
      19 x mode transition:
        OffToStartup: entered-mode=Startup, exited-mode=MachineState/Off
        StandbyToShutdown: entered-mode=MachineState/Shutdown, exited-mode=Standby
        StandbyToStartup: entered-mode=Startup, exited-mode=Standby
        StartupToReset: entered-mode=Reset, exited-mode=Startup
        StartupToRestart: entered-mode=MachineState/Restart, exited-mode=Startup
        StartupToShutdown: entered-mode=MachineState/Shutdown, exited-mode=Startup
        StartupToStandby: entered-mode=Standby, exited-mode=Startup
        StartupToUpdate: actions=Update, entered-mode=Update, exited-mode=Startup
        StartupToVerify: entered-mode=Verify, exited-mode=Startup
        UpdateToReset: entered-mode=Reset, exited-mode=Update
        UpdateToStartup: actions=Startup, entered-mode=Startup, exited-mode=Update
        VerifyToRestart: entered-mode=MachineState/Restart, exited-mode=Verify
        VerifyToStartup: entered-mode=Startup, exited-mode=Verify
        OffToPreStartup: entered-mode=PreStartup, exited-mode=MachineState/Off
        PreStartupToStartup: entered-mode=Startup, exited-mode=PreStartup
        StartupToPreStartup: entered-mode=PreStartup, exited-mode=Startup
        PreStartupToUpdate: entered-mode=Update, exited-mode=PreStartup
        UpdateToPreStartup: entered-mode=PreStartup, exited-mode=Update
        PreStartupToReset: entered-mode=Reset, exited-mode=PreStartup
