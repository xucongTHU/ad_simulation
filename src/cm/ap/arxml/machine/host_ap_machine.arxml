AUTOSAR XML (schema 00048)
package /HuaweiMDC/Ethernet
  ethernet cluster Host0DpEthernetCluster
    ethernet physical channel Host0DpEthernetPhysicalChannel: comm-connectors=Host0DpEthernetCommConnector
      network endpoint Host0DpNetworkEndpoint
        network-endpoint-addresses:
          default-gateway=127.0.0.1, ipv-4-address=192.168.10.6, network-mask=255.255.255.0
          ipv-4-address=239.192.255.123
package /HuaweiMDC/Machine
  machine Host0DpMachine: default-application-timeout={enter-timeout-value=8.0, exit-timeout-value=8.0}, environment-variables=tag-with-optional-value={key=LD_LIBRARY_PATH, value=/usr/lib/mdc/base-plat/:/opt/platform/mdc_platform/lib/:/lib64:/lib:$LD_LIBRARY_PATH}, machine-design=Host0DpMachineDesign, trusted-platform-executable-launch-behavior=MONITOR-MODE
    function-groups:
      18 x mode declaration group prototype:
        ApToRosEventSample: type=Sample
        CmDdsEventAsyncSample: type=EventAsyncSampleFunctionGroup
        CmDdsEventSyncSample: type=Sample
        CmDdsFieldSample: type=Sample
        CmDdsMethodKeventSample: type=Sample
        CmSomeipMethodFireforgetSample: type=Sample
        CmSomeipMethodKpollSample: type=Sample
        MachineState: type=MachineState
        HcfiSample: type=Sample
        SmSampleFG1: type=SmSampleFG1
        SmSampleFG2: type=SmSampleFG2
        SmSampleFG0: type=SmSampleFG0
        CanSample: type=Sample
        EmSampleFG: type=Sample
        LogSample: type=Sample
        PerSample: type=Sample
        CryptoSample: type=Sample
        Access: type=Access
    os module instantiation OS
      resource group ResourceLimit
    processor Cpu
      8 x processor core:
        Processor0_Core{0..7}: core-id={0..7}
  machine design Host0DpMachineDesign
    ethernet communication connector Host0DpEthernetCommConnector: unicast-network-endpoint=Host0DpNetworkEndpoint
package /HuaweiMDC/SomeipSdConfig
  someip sd client event group timing config Host0DpSomeipSdClientEventGroupTimingConfig: request-response-delay={max-value=1.5, min-value=1.5}, time-to-live=10
  someip sd client service instance config Host0DpSomeipSdClientServiceInstanceConfig: initial-find-behavior={initial-delay-max-value=0.1, initial-delay-min-value=0.01, initial-repetitions-base-delay=0.2, initial-repetitions-max=3}, service-find-time-to-live=10
  someip sd server service instance config Host0DpSomeipSdServerServiceInstanceConfig: initial-offer-behavior={initial-delay-max-value=0.1, initial-delay-min-value=0.01, initial-repetitions-base-delay=0.2, initial-repetitions-max=3}, offer-cyclic-delay=2.0, request-response-delay={max-value=1.5, min-value=1.5}, service-offer-time-to-live=10
